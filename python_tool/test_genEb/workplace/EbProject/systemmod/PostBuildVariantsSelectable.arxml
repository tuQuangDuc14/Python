AUTOSAR XML (schema 4-2-1)
package /EB/PostBuildSelectable
  predefined variant VS0: post-build-variant-criterion-value-set=PostBuildCriterionValueSet_VS0
  predefined variant Vs1: post-build-variant-criterion-value-set=PostBuildCriterionValueSet_Vs1
  post build variant criterion value set PostBuildCriterionValueSet_VS0: post-build-variant-criterion-value{variant-criterion=MyCriterion, value=0}
  post build variant criterion value set PostBuildCriterionValueSet_Vs1: post-build-variant-criterion-value{variant-criterion=MyCriterion, value=1}
package /EB/PostBuildSelectable/Criterions
  post build variant criterion MyCriterion: compu {0=, 1=}
